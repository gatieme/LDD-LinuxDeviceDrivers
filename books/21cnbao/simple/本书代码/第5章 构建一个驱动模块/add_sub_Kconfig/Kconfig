## books/21cnbao/simple/本书代码/第5章 构建一个驱动模块/add_sub_Kconfig/Kconfig
```kconfig
#
# add_sub configuration
#
menu "ADD_SUB"
	comment "ADD_SUB"

config CONFIG_ADD_SUB
	boolean "ADD_SUB support"
	default y

config CONFIG_TEST
	tristate "ADD_SUB test support" 
	depends on CONFIG_ADD_SUB
	default y

endmenu
```
